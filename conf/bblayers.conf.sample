## conf/bblayers.conf.sample
```bitbake
# LAYER_CONF_VERSION is inclreated each time in /build/conf/bbllayers.conf
LAYER_CONF_VERSION = "6"

BBPATH = "${TOPDIR}"
BSPDIR := "${@os.path.abspath(os.path.dirname(d.getVar('FILE', True)) + '/../..')}"

BBFILES ?= ""
BBLAYERS = " \
   \
  ${BSPDIR}/sources/poky/meta-poky \
  ${BSPDIR}/sources/poky/meta-yocto-bsp \
  \
  ${BSPDIR}/sources/openembedded-core/meta \
  ${BSPDIR}/sources/meta-openembedded/meta-oe \
  ${BSPDIR}/sources/meta-openembedded/meta-python \
  ${BSPDIR}/sources/meta-openembedded/meta-filesystems \
  ${BSPDIR}/sources/meta-openembedded/meta-networking \
  ${BSPDIR}/sources/meta-openembedded/meta-multimedia \
  ${BSPDIR}/sources/meta-openembedded/meta-webserver \
  \
  ${BSPDIR}/sources/meta-virtualization \
  \
  ${BSPDIR}/sources/meta-freescale \
  ${BSPDIR}/sources/meta-freescale-3rdparty \
  ${BSPDIR}/sources/meta-freescale-distro \
  \
  ${BSPDIR}/sources/meta-raspberrypi \
  \
  ${BSPDIR}/sources/meta-rust-bin \
  ${BSPDIR}/sources/meta-qt6 \
  ${BSPDIR}/sources/meta-jupyter \
  \
  ${BSPDIR}/sources/ams/meta-ams \
  ${BSPDIR}/sources/ams/meta-ams-bsp \
"

# core layer same as openembedded-core/meta
excluded = " ${BSPDIR}/sources/poky/meta "
```

## meta-ams-app/conf/layer.conf
```bitbake
# We have a conf and classes directory, add to BBPATH
BBPATH =. "${LAYERDIR}:"

BBFILE_COLLECTIONS += "ams-app"
BBFILE_PATTERN_ams-app = "^${LAYERDIR}/"

BBFILE_PRIORITY_ams-app = "46"
LAYERVERSION_ams-app = "4"
LAYERSERIES_COMPAT_ams-app = "kirkstone mickledore"

LAYERDEPENDS_ams-app = "core"

# Set a variable to get to the top of the metadata location
PLOSCOREBASE = '${@os.path.normpath("${LAYERDIR}/../")}'
# Add your custom license files into one of this directories.
# LICENSE_PATH += "${LAYERDIR}/files/custom-licenses"

BBFILES += "${LAYERDIR}/recipes-*/*/*.bb \
            ${LAYERDIR}/recipes-*/*/*.bbappend"

BBFILES_DYNAMIC += " \
    chromium-browser-layer:${LAYERDIR}/dynamic-layers/chromium-browser-layer/*/*/*.bb \
    chromium-browser-layer:${LAYERDIR}/dynamic-layers/chromium-browser-layer/*/*/*.bbappend \
    \
    openembedded-layer:${LAYERDIR}/dynamic-layers/openembedded-layer/*/*/*.bb \
    openembedded-layer:${LAYERDIR}/dynamic-layers/openembedded-layer/*/*/*.bbappend \
    \
    webserver:${LAYERDIR}/dynamic-layers/openembedded-webserver-layer/*/*/*.bb \
    webserver:${LAYERDIR}/dynamic-layers/openembedded-webserver-layer/*/*/*.bbappend \
    \
    qt6-layer:${LAYERDIR}/dynamic-layers/qt6-layer/*/*/*.bb \
    qt6-layer:${LAYERDIR}/dynamic-layers/qt6-layer/*/*/*.bbappend \
"
```

## meta-ams-bsp-imx/conf/layer.conf
```bitbake
# We have a conf and classes directory, add to BBPATH
BBPATH .= ":${LAYERDIR}"

# We have recipes-* directories, add to BBFILES
BBFILES += "${LAYERDIR}/recipes-*/*/*.bb \
            ${LAYERDIR}/recipes-*/*/*.bbappend"

BBFILE_COLLECTIONS += "amsbsprpi"
BBFILE_PATTERN_ams-bsp-imx = "^${LAYERDIR}/"
BBFILE_PRIORITY_ams-bsp-imx = "6"
LAYERVERSION_ams-bsp-imx = "2"
LAYERSERIES_COMPAT_ams-bsp-imx = " sumo warrior "

LAYERDEPENDS_ams-bsp-imx = "meta-freescale meta-fsl"
```

## meta-ams-bsp-phytecimx8/conf/layer.conf
```bitbake
# We have a conf and classes directory, add to BBPATH
BBPATH .= ":${LAYERDIR}"

# We have recipes-* directories, add to BBFILES
BBFILES += "${LAYERDIR}/recipes-*/*/*.bb \
            ${LAYERDIR}/recipes-*/*/*.bbappend"

BBFILE_COLLECTIONS += "ams-bsp-phytecimx8"
BBFILE_PATTERN_ams-bsp-phytecimx8 = "^${LAYERDIR}/"
BBFILE_PRIORITY_ams-bsp-phytecimx8 = "30"
LAYERVERSION_ams-bsp-phytecimx8 = "3"
LAYERSERIES_COMPAT_ams-bsp-phytecimx8 = "dunfell gatesgarth hardknott"

LAYERDEPENDS_ams-bsp-phytecimx8 = "ams-bsp "
```

## meta-ams-bsp-rpi/conf/layer.conf
```bitbake
# We have a conf and classes directory, add to BBPATH
BBPATH .= ":${LAYERDIR}"

# We have recipes-* directories, add to BBFILES
BBFILES += "${LAYERDIR}/recipes-*/*/*.bb \
            ${LAYERDIR}/recipes-*/*/*.bbappend"

BBFILE_COLLECTIONS += "amsbsprpi"
BBFILE_PATTERN_amsbsprpi = "^${LAYERDIR}/"
BBFILE_PRIORITY_amsbsprpi = "6"
LAYERVERSION_amsbsprpi = "2"
LAYERSERIES_COMPAT_amsbsprpi = "kirkstone langdale"

LAYERDEPENDS_amsbsprpi = "raspberrypi"
```

## meta-ams-bsp-rpi/conf/machine/qemuarma9.conf
```bitbake
#@TYPE: Machine
#@NAME: arm_vexpressa9
#@DESCRIPTION: "Machine configuration running a Cortext A9"

require conf/machine/include/qemu.inc
DEFAULTTUNE = "armv7ahf"
require conf/machine/include/tune-cortexa9.inc

COMPATIBLE_MACHINE_qemuarma9 = "armv7a"
CRIU_BUILD_ARCH = "armv7"

KBRANCH_qemuarma9 ?= "standard/arm-versatile-926ejs"
KERNEL_DEVICETREE_qemuarma9 = "vexpress-v2p-ca9.dtb"
COMPATIBLE_MACHINE_qemuarma9 = "qemuarma9"
KERNEL_IMAGETYPE = "zImage"
SERIAL_CONSOLES ?= "115200;ttyAMA0 115200;ttyAMA1"

PCMCIA_MANAGER = "pcmciautils"
PREFERRED_PROVIDER_virtual/xserver ?= "xserver-kdrive"
PREFERRED_PROVIDER_virtual/libgl ?= "mesa"

MACHINE_FEATURES = "pcmcia screen"

# Set image size for MMC disk
IMAGE_ROOTFS_EXTRA_SPACE = "0"
IMAGE_ROOTFS_SIZE = "3801088"
INITRAMFS_MAXSIZE = "3801088"
IMAGE_ROOTFS_ALIGNMENT = "1"
IMAGE_FSTYPES += "tar.bz2 tar.xz tar.gz"


# For runqemu
QB_SYSTEM_NAME = "qemu-system-arm"
QB_MACHINE = "-machine vexpress-a9"
QB_KERNEL_CMDLINE_APPEND = "console=ttyAMA0,115200 console=tty"
# vexpress does not have any PCI bus to support virtio-rng-pci,
# We define specific virtio block device for it.
QB_ROOTFS_OPT = "-drive id=disk0,file=@ROOTFS@,if=none,format=raw -device virtio-blk-device,drive=disk0"
QB_TAP_OPT = "-netdev tap,id=net0,ifname=@TAP@,script=no,downscript=no -device virtio-net-device,netdev=net0,mac=@MAC@"
QB_SLIRP_OPT = "-netdev user,id=net0"
QB_OPT_APPEND = "-show-cursor -device virtio-rng-device"
QB_DTB = "zImage-vexpress-v2p-ca9.dtb"
# Overwrite virtio-net-pci defined in oe-core/meta/classes/qemuboot.bbclass,
# since vexpress does not support it.
QB_NETWORK_DEVICE = "-device virtio-net-device,netdev=net0"

# QEMU more option candidates - to be explored later
##QB_MEM = "-m 512"
##QB_SERIAL_OPT = "-device virtio-serial-device -chardev null,id=virtcon -device virtconsole,chardev=virtcon"
##QB_TCPSERIAL_OPT = " -device virtio-serial-device -chardev socket,id=virtcon,port=@PORT@,host=127.0.0.1 -device virtconsole,chardev=virtcon"
```

## meta-ams-bsp-rpi/conf/machine/quirin.conf
```bitbake
#@TYPE: Machine
#@NAME: Board Configuration "quirin"
#@COM: qemux86
#@DESCRIPTION: Board Configuration "quirin" (based on qemux86, display)
#@MAINTAINER: Volker Kempert <volker.kempert@almedso.de>


MACHINEOVERRIDES = "qemux86-64:${MACHINE}"
require conf/machine/qemux86-64.conf

KMACHINE_quirin = "qemux86-64"

CORE_IMAGE_EXTRA_INSTALL += "wayland weston"


DISTRO_FEATURES:append = "wayland opengl egl gles gbm dri gallium gallium-llvm virgl"
MACHINE_FEATURE:append = "virgl virglrenderer-native  wayland virtio-gpu "
DISTRO_FEATURES:remove = "wifi"
MACHINE_FEATURES:remove = "wifi"

PACKAGECONFIG_WAYLAND:append = "xkbcommon-evdev"

PACKAGECONFIG:append:pn-mesa = "gallium"
PACKAGECONFIG:append:pn-qtbase = "kms gbm eglfs tools gles2 examples"

GALLIUMDRIVERS:append:pn-mesa = ",virgl"

IMAGE_FSTYPES:append = " wic"
```

## meta-ams-bsp-rpi/conf/machine/riotboard.conf
```bitbake
#@TYPE: Machine
#@NAME: Board Configuration riotboard
#@SOC: i.MX6 Solo
#@COM: riotboard
#@DESCRIPTION: Machine configuration for Board Configuration riotboard

# derived from riotboard
include conf/machine/imx6dl-riotboard.conf

SOC_FAMILY_append = ":imx6dl-riotboard"

# Add gstreamer plugins provided by Freescale
# MACHINE_EXTRA_RRECOMMENDS += "gst-fsl-plugin"

IMAGE_FSTYPES += "tar.gz wic wic.bmap"

# control which files go into the boot partion via wic
# IMAGE_BOOT_FILES = "u-boot.img uImage"


# kernel additional command line args

# sdcard image definition
# a boot partition is needed ( - overwrite imx-uboot.wks)
#
# imx-uboot-bootpart.wks is not available at warrior anymore
# WKS_FILES = "imx-uboot-bootpart.wks"
```

## meta-ams-bsp-rpi/conf/machine/rpi2-2in7epaper.conf
```bitbake
#@TYPE: Machine
#@NAME: Board Configuration rpi2-2in7epaper
#@DESCRIPTION: Board Configuration based on raspberrypi2, with 2.7 inch ePaper display
#@MAINTAINER: Volker Kempert <volker.kempert@almedso.de>

# see  https://readthedocs.org/projects/meta-raspberrypi/
# 2.7 inch display:
# - https://www.waveshare.com/product/displays/e-paper/2.7inch-e-paper-hat.htm
# - https://www.waveshare.com/wiki/2.7inch_e-Paper_HAT_Manual#Working_With_Raspberry_Pi
# - demo/dirver: https://github.com/waveshare/e-Paper

MACHINEOVERRIDES = "raspberrypi2:${MACHINE}"
require conf/machine/raspberrypi2.conf

MACHINE_FEATURES:remove = "keyboard screen touchscreen alsa sdio"

# Enable the console (as serial0 in kernel cmdline.txt) and in config.txt
ENABLE_UART = "1"

IMAGE_FSTYPES += "wic"
# WKS_FILE = "sdimage-bootpart.wks"
# extra rootfs size in kbyte e.g. 4 GB here
IMAGE_ROOTFS_EXTRA_SPACE = "4194304"

SPLASH = ""

ENABLE_SPI_BUS = "1"
ENABLE_I2C = "1"
RPI_EXTRA_CONFIG += "dtoverlay=spi0-1cs"

KERNEL_MODULE_AUTOLOAD_rpi += "i2c-dev i2c-bcm2708"
```

## meta-ams-bsp-rpi/conf/machine/rpi3-cam.conf
```bitbake
#@TYPE: Machine
#@NAME: Board Configuration rpi3-cam
#@DESCRIPTION: Board Configuration based on raspberrypi3, w/ high res camera driver
#@MAINTAINER: Volker Kempert <volker.kempert@almedso.de>

# see  https://readthedocs.org/projects/meta-raspberrypi/
# explorer: https://joy-it.net/de/products/RB-Explorer700
# camera v2: https://randomnerdtutorials.com/guide-to-raspberry-pi-camera-v2-module/
# camera ref.1.3: https://uk.pi-supply.com/products/raspberry-pi-camera-board-v1-3-5mp-1080p
#                 https://circuit.rocks/raspberry-pi-camera.html

MACHINEOVERRIDES = "raspberrypi3:${MACHINE}"
require conf/machine/raspberrypi3.conf

MACHINE_FEATURES:remove = "keyboard screen touchscreen alsa sdio"

# Enable the console (as serial0 in kernel cmdline.txt) and in config.txt
ENABLE_UART = "1"

IMAGE_FSTYPES += "wic"
# WKS_FILE = "sdimage-bootpart.wks"
# extra rootfs size in kbyte e.g. 4 GB here
IMAGE_ROOTFS_EXTRA_SPACE = "4194304"

SPLASH = ""

ENABLE_SPI_BUS = "1"
ENABLE_I2C = "1"
RPI_EXTRA_CONFIG += "dtoverlay=spi0-1cs"

KERNEL_MODULE_AUTOLOAD_rpi += "i2c-dev i2c-bcm2708"

# video for linix driver support
VIDEO_CAMERA = "1"
RASPBERRYPI_CAMERA_V2 = "1"
```

## meta-ams-bsp-rpi/conf/machine/rpi3-expl700+cam.conf
```bitbake
#@TYPE: Machine
#@NAME: Board Configuration rpi3-expl700+coam
#@DESCRIPTION: Board Configuration based on raspberrypi3, with explorer700 shield and  camera ref 1.3.
#@MAINTAINER: Volker Kempert <volker.kempert@almedso.de>
# see  https://readthedocs.org/projects/meta-raspberrypi/


DEFAULTTUNE ?= "cortexa7thf-neon-vfpv4"
require conf/machine/include/arm/armv7a/tune-cortexa7.inc
include conf/machine/include/rpi-base.inc

MACHINE_EXTRA_RRECOMMENDS += "\
    linux-firmware-rpidistro-bcm43430 \
    linux-firmware-rpidistro-bcm43455 \
    bluez-firmware-rpidistro-bcm43430a1-hcd \
    bluez-firmware-rpidistro-bcm4345c0-hcd \
"

SDIMG_KERNELIMAGE ?= "kernel7.img"
UBOOT_MACHINE = "rpi_3_32b_config"
SERIAL_CONSOLES ?= "115200;ttyS0"

VC4DTBO ?= "vc4-fkms-v3d"
ARMSTUB ?= "armstub7.bin"

    # make sure the raspberrypi 3 (w/o 64 bit) kernel adaptation is foun
MACHINEOVERRIDES =. "raspberrypi3:"

MACHINE_FEATURES:remove = "keyboard screen touchscreen alsa sdio"

# Enable the console (as serial0 in kernel cmdline.txt) and in config.txt
ENABLE_UART = "1"

IMAGE_FSTYPES += "wic"
# WKS_FILE = "sdimage-bootpart.wks"
# extra rootfs size in kbyte e.g. 4 GB here
IMAGE_ROOTFS_EXTRA_SPACE = "4194304"

SPLASH = ""

ENABLE_SPI_BUS = "1"
ENABLE_I2C = "1"
RPI_EXTRA_CONFIG = "dtoverlay=pi3-disable-bt"
RPI_EXTRA_CONFIG += "dtoverlay=spi0-1cs"

KERNEL_MODULE_AUTOLOAD_rpi += "i2c-dev i2c-bcm2708"

# video for linix driver support
VIDEO_CAMERA = "1"
RASPBERRYPI_CAMERA_V2 = "1"
```

## meta-ams-bsp-rpi/conf/machine/rpi3-touch-hmi.conf
```bitbake
#@TYPE: Machine
#@NAME: Board configuration rpi3-touch-hmi
#@COM: raspberrypi
#@DESCRIPTION: Board configuration  raspberrypi3, w/ touch, w/ display)
#@MAINTAINER: Volker Kempert <volker.kempert@almedso.de>

MACHINEOVERRIDES = "raspberrypi3:${MACHINE}"
require conf/machine/raspberrypi3.conf

# MACHINE_FEATURES_remove = "sdio"
# Driver to support weston / graphics
MACHINE_FEATURES += "vc4graphics"

# Remove black border
DISABLE_OVERSCAN = "1"

# Heavily recommended for Wayland/Weston.
DISPMANX_OFFLINE = "1"

GPU_MEM = "128"

IMAGE_FSTYPES += "wic"

SPLASH = "psplash-ams"

# Touch screen setting
WAVESHARE_800X480_RPI = "1"
MACHINE_FEATURES += "ads7846-touch"

KERNEL_DEVICETREE = " \
    bcm2710-rpi-3-b.dtb \
    "

dtoverlay=""
ENABLE_UART = "1"
ENABLE_KGBD = "1"
ENABLE_I2C = "1"


KERNEL_MODULE_AUTOLOAD:rpi += "i2c-dev i2c-bcm2708"

MACHINE_EXTRA_RRECOMMENDS += " rpi-config"

RPI_USE_U_BOOT = "1"
```
