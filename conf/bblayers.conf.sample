## meta-ams-bsp/conf/distro/ams-bsp.conf
```bitbake
# Distro meta data
#------------------------------------------------------------------------------
DISTRO = "ams-bsp"
DISTRO_NAME = "AMS BSP Development Distribution"
DISTRO_VERSION = "2023-Q1"
BUILD_VARIANT = "prod"
DISTRO_VERSION = "kirkstone"
VENDOR = "almedso"
TARGET_VENDOR = "-${VENDOR}"

# SDK definitions
#------------------------------------------------------------------------------
SDK_VENDOR = "-${VENDOR}sdk"
SDK_VERSION := "${DISTRO_VERSION}"
SDK_NAME = "${VENDOR}-${DISTRO}-${TCLIBC}-${SDK_ARCH}-${IMAGE_BASENAME}-${TUNE_PKGARCH}"
SDKPATH = "/opt/${VENDOR}-${DISTRO}/${SDK_VERSION}"

# General definitions
#------------------------------------------------------------------------------
PACKAGE_CLASSES ?= "package_ipk"
OPKG_ARGS:remove = "--prefer-arch-to-version"

VIRTUAL-RUNTIME_dev_manager = "udev"
VIRTUAL-RUNTIME_init_manager = "systemd"
DISTRO_FEATURES_BACKFILL_CONSIDERED += "sysvinit"
VIRTUAL-RUNTIME_login_manager = "busybox"
VIRTUAL-RUNTIME_syslog = ""
VIRTUAL-RUNTIME_initscripts = ""
DISTRO_FEATURES_RUNTIME_MANAGER = "systemd polkit"

# Distro features
#------------------------------------------------------------------------------
DISTRO_FEATURES = "\
  ${DISTRO_FEATURES_RUNTIME_MANAGER} \
  "
DISTRO_FEATURES += "alsa"
# support of autoresize through InitRD
DISTRO_FEATURES += "autoresize"
DISTRO_FEATURES += "3g"
DISTRO_FEATURES += "bluez5"
DISTRO_FEATURES += "bluetooth"
DISTRO_FEATURES += "ext2"
DISTRO_FEATURES += "ext4"
DISTRO_FEATURES += "ipv4 ipv6"
DISTRO_FEATURES += "gplv"
DISTRO_FEATURES += "gstreamer"
# support of InitRD installation package
# DISTRO_FEATURES += "initrd"
DISTRO_FEATURES += "irda"
DISTRO_FEATURES += "largefile"
DISTRO_FEATURES += "libc-locales"
DISTRO_FEATURES += "multiarch"
DISTRO_FEATURES += "opengl"
DISTRO_FEATURES += "pci"
DISTRO_FEATURES += "ptest"
# Software update
# DISTRO_FEATURES += "swupdate"
# DISTRO_FEATURES += "rauc"
DISTRO_FEATURES += "usbgadget"
DISTRO_FEATURES += "usbhost"
DISTRO_FEATURES += "vendor"
DISTRO_FEATURES += "vulcan"
# support of wayland
DISTRO_FEATURES:append = " wayland pam "
DISTRO_FEATURES += "wifi"
DISTRO_FEATURES += "xattr"
DISTRO_FEATURES += "zeroconf"

DISTRO_EXTRA_RDEPENDS = "packagegroup-core-boot"

# INITRD addons to image
# DISTRO_EXTRA_RRECOMMENDS:append = " ${@bb.utils.contains('COMBINED_FEATURES', 'initrd', '${INITRD_PACKAGE}', '', d)} "

# Preferred providers and versions
#------------------------------------------------------------------------------
PREFERRRED_PROVIDER_linux-mfgtool-base = "linux-imx-mfgtool"

# Sanity checks and QA checks
#------------------------------------------------------------------------------
SANITY_TESTED_DISTROS = " \
  ubuntu-20.04 \n \
  "

# QA check settings - a little stricter than the OE-Core defaults
WARN_TO_ERROR_QA = "already-stripped compile-host-path install-host-path \
                    installed-vs-shipped ldflags pn-overrides rpaths staticdev \
                    unknown-configure-option useless-rpaths"
ERROR_TO_WARN_QA = "version-going-backwards"
ERROR_QA:remove = "${ERROR_TO_WARN_QA}"
WARN_QA:append = " ${ERROR_TO_WARN_QA}"
#
# OELAYOUT_ABI allows us to notify users when the format of TMPDIR changes in
# an incompatible way. Such changes should usually be detailed in the commit
# that breaks the format and have been previously discussed on the mailing list
# with general agreement from the core team.
OELAYOUT_ABI = "15"

# Miscellaneous settings
#------------------------------------------------------------------------------
# Some ptests (glibc, bash, python3) depend
# on other locales to be included
GLIBC_GENERATE_LOCALES = " \
    de_DE.UTF-8 \
    el_GR.UTF-8 \
    en_GB.UTF-8 \
    en_US.UTF-8 \
    es_ES.UTF-8 \
    fa_IR.UTF-8 \
    fi_FI.UTF-8 \
    fr_FR.ISO-8859-1 \
    fr_FR.UTF-8 \
    hr_HR.UTF-8 \
    it_IT.UTF-8 \
    ja_JP.EUC-JP \
    lt_LT.UTF-8 \
    nb_NO.UTF-8 \
    nl_NL.UTF-8 \
    nn_NO.UTF-8 \
    pl_PL.UTF-8 \
    pl_PL.ISO-8859-2 \
    pt_BR.UTF-8 \
    pt_PT.UTF-8 \
    ru_RU.UTF-8 \
    sv_SE.UTF-8 \
    tr_TR.UTF-8 \
    tr_TR.ISO-8859-9 \
    zh_HK.BIG5-HKSCS \
"

IMAGE_LINGUAS = "en-us"
ENABLE_BINARY_LOCALE_GENERATION = "1"

# License settings
#------------------------------------------------------------------------------
LICENSE_FLAGS_ACCEPTED += "commercial non-commercial"
```

## meta-ams-bsp/conf/distro/ams-common.inc
```bitbake
DISTRO_VERSION ??= "UNASSIGNED"
DISTRO_VERSION ?= "hardknott"

VENDOR = "almedso"
TARGET_VENDOR = "-${VENDOR}"

SDK_VENDOR = "-${VENDOR}sdk"
SDK_VERSION := "${DISTRO_VERSION}"
SDK_NAME = "${VENDOR}-${DISTRO}-${TCLIBC}-${SDK_ARCH}-${IMAGE_BASENAME}-${TUNE_PKGARCH}"
SDKPATH = "/opt/${VENDOR}-${DISTRO}/${SDK_VERSION}"

# Prelink images
INHERIT += "image-prelink"

# optimize lib sizes with mklibs
INHERIT += "image-mklibs"

# Package handling
PACKAGE_CLASSES ?= "package_ipk"
OPKG_ARGS_remove = "--prefer-arch-to-version"

# It's a prebuild glibc designed to remove the differences between
# host distros, meaning that native sstate objects can be shared
# between host distros.
# Move listet checks from ERROR_QA to WARN_QA (defined in insane.bbclass)
ERROR_TO_WARN_QA = "version-going-backwards"
ERROR_QA_remove = "${ERROR_TO_WARN_QA}"
WARN_QA_append = " ${ERROR_TO_WARN_QA}"

# suppress meta-virtualization useless warning when building
# without virtualization distro feature
SKIP_META_VIRT_SANITY_CHECK = "1"

# Suppress meta-rauc warning when building without rauc distro feature. We only
# activate this distro feature when needed in distros tailored for this
# use-case.
SKIP_META_RAUC_FEATURE_CHECK = "1"

VIRTUAL-RUNTIME_dev_manager = "udev"
VIRTUAL-RUNTIME_init_manager = "systemd"
DISTRO_FEATURES_BACKFILL_CONSIDERED += "sysvinit"
VIRTUAL-RUNTIME_login_manager = "busybox"
VIRTUAL-RUNTIME_syslog = ""
VIRTUAL-RUNTIME_initscripts = ""

# some default locales
IMAGE_LINGUAS ?= "de-de en-us"
```

## meta-ams-bsp/conf/layer.conf
```bitbake
# We have a conf and classes directory, add to BBPATH
BBPATH .= ":${LAYERDIR}"

BBFILE_COLLECTIONS += "ams-bsp"
BBFILE_PATTERN_ams-bsp = "^${LAYERDIR}/"

BBFILE_PRIORITY_ams-bsp = "50"
LAYERVERSION_ams-bsp = "3"
LAYERSERIES_COMPAT_ams-bsp = "kirkstone mickledore"

LAYERDEPENDS_ams-bsp = "core"

# We have recipes-* directories, add to BBFILES
BBFILES += "${LAYERDIR}/recipes-*/*/*.bb \
            ${LAYERDIR}/recipes-*/*/*.bbappend"

BBFILES_DYNAMIC += " \
    meta-arm:${LAYERDIR}/bbappends/meta-arm/recipes-*/*/*.bb \
    meta-arm:${LAYERDIR}/bbappends/meta-arm/recipes-*/*/*.bbappend \
    phytec:${LAYERDIR}/bbappends/meta-phytec/recipes-*/*/*.bb \
    phytec:${LAYERDIR}/bbappends/meta-phytec/recipes-*/*/*.bbappend \
    raspberrypi:${LAYERDIR}/bbappends/meta-raspberrypi/recipes-*/*/*.bb \
    raspberrypi:${LAYERDIR}/bbappends/meta-raspberrypi/recipes-*/*/*.bbappend \
    stm-st-stm32mp:${LAYERDIR}/bbappends/meta-st-stm32mp/recipes-*/*/*.bb \
    stm-st-stm32mp:${LAYERDIR}/bbappends/meta-st-stm32mp/recipes-*/*/*.bbappend \
    variscite-bsp:${LAYERDIR}/bbappends/meta-variscite/recipes-*/*/*.bb \
    variscite-bsp:${LAYERDIR}/bbappends/meta-variscite/recipes-*/*/*.bbappend \
"
```

## meta-ams-bsp/conf/machine/imx93-var-som-m33.conf
```bitbake
#@TYPE: Machine
#@NAME: Variscite VAR-SOM-MX93
#@SOC: i.MX93
#@DESCRIPTION: Machine configuration for Variscite VAR-SOM-MX93
#@MAINTAINER: Nate Drude <nate.d@variscite.com>
#
# http://www.variscite.com
MACHINEOVERRIDES =. "imx93-var-som:mx93:"

require conf/machine/include/imx-base.inc
require conf/machine/include/arm/armv8-2a/tune-cortexa55.inc

require conf/machine/variscite.inc

# Variscite BSP default providers
PREFERRED_PROVIDER_virtual/kernel:imx93-var-som-m33 ?= "linux-variscite"
PREFERRED_PROVIDER_u-boot:imx93-var-som-m33 ?= "u-boot-variscite"
PREFERRED_PROVIDER_u-boot-fw-utils:imx93-var-som-m33 ?= "u-boot-fw-utils"
PREFERRED_PROVIDER_virtual/bootloader:imx93-var-som-m33 ?= "u-boot-variscite"
PREFERRED_RPROVIDER_ethos-u-firmware ?= "freertos-variscite"

MACHINE_FEATURES += "nxpiw612-sdio"

KERNEL_DEVICETREE = " \
    freescale/imx93-var-som-symphony-m33.dtb \
"
UBOOT_DTB_NAME = "imx93-var-som-symphony-m33.dtb"

LOADADDR = ""
UBOOT_SUFFIX = "bin"
UBOOT_MAKE_TARGET = ""

SPL_BINARY = "spl/u-boot-spl.bin"

UBOOT_CONFIG ??= "sd"
UBOOT_CONFIG[sd]   = "imx93_var_som_defconfig,sdcard"

# Set ATF platform name
ATF_PLATFORM = "imx93"

IMXBOOT_TARGETS_SD   = "flash_singleboot"
IMXBOOT_TARGETS = "${IMXBOOT_TARGETS_SD}"

IMX_BOOT_SOC_TARGET = "iMX9"
IMX_BOOT_SEEK = "32"

# We have to disable SERIAL_CONSOLE due to auto-serial-console
SERIAL_CONSOLES = "115200;ttyLP0"

# Cortex-M33 firmware integration
APP_TARGET_NAME = "m33-firmware"
MACHINE_FIRMWARE:append = " freertos-cortex-m "
# disable the NPU firmware that runs on M33 since we use the M33 for other purposes
MACHINE_FIRMWARE:remove = "ethos-u-firmware"

DDR_FIRMWARE_NAME = " \
        lpddr4_dmem_1d_v202201.bin \
        lpddr4_dmem_2d_v202201.bin \
        lpddr4_imem_1d_v202201.bin \
        lpddr4_imem_2d_v202201.bin \
"

SECO_FIRMWARE_NAME:mx9-nxp-bsp = "mx93a0-ahab-container.img"

# we do not want any imx-m33 demos since we install freertos-cortex-m firmware
MACHINE_EXTRA_RRECOMMENDS:remove = "imx-m33-demos"
# add to linux kernel cmdline args for not disabling unused clocks - it causes rpmsg to fail
APPEND += " clk_ignore_unused"
```

## meta-ams-bsp/conf/machine/qemuarma9.conf
```bitbake
#@TYPE: Machine
#@NAME: arm_vexpressa9
#@DESCRIPTION: "Machine configuration running a Cortext A9"

require conf/machine/include/qemu.inc
require conf/machine/include/tune-cortexa9.inc


KERNEL_IMAGETYPE = "zImage"
KMACHINE_qemuarm = "qemuarma9"
DEFAULT_TUNE = "armv7ahv-neon"
COMPATIBLE_MACHINE_qemuarma9 = "armv7a"
SERIAL_CONSOLES ?= "115200;ttyAMA0 115200;ttyAMA1"

# For runqemu
QB_SYSTEM_NAME = "qemu-system-arm"
QB_MACHINE = "-machine vexpress-a9"
QB_KERNEL_CMDLINE_APPEND = "console=ttyAMA0,115200 console=tty"

# Add the 'virtio-rng-pci' device otherwise the guest may run out of entropy
QB_OPT_APPEND = "-show-cursor"

PREFERRED_VERSION_linux-yocto ??= "4.18%"
# QB_DTB = "${@oe.utils.version_less_or_equal('PREFERRED_VERSION_linux-yocto', '4.7', '', 'zImage.dtb', d)}"
```

## meta-ams-bsp/conf/machine/qemux86-64-touch-display.conf
```bitbake
#@TYPE: Machine
#@NAME: Board Configuration qemux86-64 with display hmi
#@COM: qemux86
#@DESCRIPTION: Board Configuration based on qemux86-64, display
#@MAINTAINER: Volker Kempert <volker.kempert@almedso.de>

MACHINEOVERRIDES = "qemux86-64:${MACHINE}"
require conf/machine/qemux86-64.conf

KMACHINE:qemux86-64-touch-display = "qemux86-64"

CORE_IMAGE_EXTRA_INSTALL += "wayland weston"


DISTRO_FEATURES:append = "wayland opengl egl gles gbm dri gallium gallium-llvm virgl"
MACHINE_FEATURE:append = "virgl virglrenderer-native  wayland virtio-gpu "
DISTRO_FEATURES:remove = "wifi"
MACHINE_FEATURES:remove = "wifi"

PACKAGECONFIG_WAYLAND:append = "xkbcommon-evdev"

PACKAGECONFIG:append:pn-mesa = "gallium"
PACKAGECONFIG:append:pn-qtbase = "kms gbm eglfs tools gles2 examples"

GALLIUMDRIVERS:append:pn-mesa = ",virgl"

IMAGE_FSTYPES:append = " wic"
```

## meta-ams-bsp/conf/machine/quirin.conf
```bitbake
#@TYPE: Machine
#@NAME: Board Configuration "quirin"
#@COM: qemux86
#@DESCRIPTION: Board Configuration "quirin" (based on qemux86, display)
#@MAINTAINER: Volker Kempert <volker.kempert@almedso.de>


MACHINEOVERRIDES = "qemux86-64:${MACHINE}"
require conf/machine/qemux86-64.conf

KMACHINE_quirin = "qemux86-64"

CORE_IMAGE_EXTRA_INSTALL += "wayland weston"


DISTRO_FEATURES_append = "wayland opengl egl gles gbm dri gallium gallium-llvm virgl"
MACHINE_FEATURES_append = "virgl virglrenderer-native  wayland virtio-gpu "
DISTRO_FEATURES_remove = "wifi"
MACHINE_FEATURES_remove = "wifi"

PACKAGECONFIG_WAYLAND_append = "xkbcommon-evdev"

PACKAGECONFIG_append_pn-mesa = "gallium"
PACKAGECONFIG_append_pn-qtbase = "kms gbm eglfs tools gles2 examples"

GALLIUMDRIVERS_append_pn-mesa = ",virgl"

IMAGE_FSTYPES_append = " wic"
```

## meta-ams-bsp/conf/machine/ricardo.conf
```bitbake
#@TYPE: Machine
#@NAME: Board Configuration "ricardo"
#@COM: raspberrypi
#@DESCRIPTION: Board Configuration "ricardo" (based on raspberrypi3, w/ console)
#@MAINTAINER: Volker Kempert <volker.kempert@almedso.de>

# see  https://readthedocs.org/projects/meta-raspberrypi/

MACHINEOVERRIDES = "raspberrypi3:${MACHINE}"
require conf/machine/raspberrypi3.conf

MACHINE_FEATURES_remove = "keyboard screen touchscreen alsa sdio"

# Enable the console (as serial0 in kernel cmdline.txt) and in config.txt
ENABLE_UART = "1"

IMAGE_FSTYPES += "wic"
# WKS_FILE = "sdimage-bootpart.wks"
# extra rootfs size in kbyte e.g. 4 GB here
IMAGE_ROOTFS_EXTRA_SPACE = "4194304"

SPLASH = ""

ENABLE_SPI_BUS = "1"
ENABLE_I2C = "1"

KERNEL_MODULE_AUTOLOAD_rpi += "i2c-dev i2c-bcm2708"

# can bus support
ENABLE_SPI_BUS = "1"
ENABLE_CAN = "1"
CAN_OSCILLATOR = "8000000"

# video for linix driver support
VIDEO_CAMERA = "1"
RASPBERRYPI_CAMERA_V2 = "1"
```

## meta-ams-bsp/conf/machine/rigoletto.conf
```bitbake
#@TYPE: Machine
#@NAME: Board Configuration "Rigoletto"
#@SOC: i.MX6 Solo
#@COM: riotboard
#@DESCRIPTION: Machine configuration for Board Configuration "Rigoletto" (based on riotboard)

# derived from riotboard
include conf/machine/imx6dl-riotboard.conf

SOC_FAMILY_append = ":imx6dl-riotboard"

# Add gstreamer plugins provided by Freescale
# MACHINE_EXTRA_RRECOMMENDS += "gst-fsl-plugin"

IMAGE_FSTYPES += "tar.gz wic"

# control which files go into the boot partion via wic
# IMAGE_BOOT_FILES = "u-boot.img uImage"


# kernel additional command line args

# sdcard image definition
# a boot partition is needed ( - overwrite imx-uboot.wks)
WKS_FILES = "imx-uboot-bootpart.wks"
```

## meta-ams-bsp/conf/machine/roderigo.conf
```bitbake
#@TYPE: Machine
#@NAME: Board Configuration "roderigo (Verdi/Otello)"
#@COM: raspberrypi
#@DESCRIPTION: Board Configuration "roderigo" (based on raspberrypi, w console)
#@MAINTAINER: Volker Kempert <volker.kempert@almedso.de>


MACHINEOVERRIDES = "raspberrypi:${MACHINE}"
require conf/machine/raspberrypi.conf

MACHINE_FEATURES_remove = "keyboard screen touchscreen alsa bluetooth sdio"

# Enable the console (as serial0 in kernel cmdline.txt) and in config.txt
ENABLE_UART = "1"

IMAGE_FSTYPES += "wic"
SPLASH_DISABLE = "1"
```

## meta-ams-bsp/conf/machine/rodolfo.conf
```bitbake
#@TYPE: Machine
#@NAME: Board Configuration "rodolfo"
#@COM: raspberrypi
#@DESCRIPTION: Board Configuration "rodolfo" (based on raspberrypi0-wifi, w console)
#@MAINTAINER: Volker Kempert <volker.kempert@almedso.de>


MACHINEOVERRIDES = "raspberrypi0-wifi:${MACHINE}"
require conf/machine/raspberrypi0-wifi.conf

MACHINE_FEATURES_remove = "keyboard screen touchscreen alsa bluetooth sdio"

# Enable the console (as serial0 in kernel cmdline.txt) and in config.txt
ENABLE_UART = "1"

IMAGE_FSTYPES += "wic wic.bmap"
SPLASH = ""
```

## meta-ams-bsp/conf/machine/rpi0-wifi-can.conf
```bitbake
#@TYPE: Machine
#@NAME: Board Configuration rpi0-wifi-can
#@COM: raspberrypi
#@DESCRIPTION: Board Configuration "rodolfo" (based on raspberrypi0-wifi, w console)
#@MAINTAINER: Volker Kempert <volker.kempert@almedso.de>


MACHINEOVERRIDES = "raspberrypi0-wifi:${MACHINE}"
require conf/machine/raspberrypi0-wifi.conf

MACHINE_FEATURES:remove = "keyboard screen touchscreen alsa bluetooth sdio"
MACHINE_FEATURES:append = " can "

# Enable the console (as serial0 in kernel cmdline.txt) and in config.txt
ENABLE_UART = "1"

IMAGE_FSTYPES += "wic wic.bmap"
SPLASH = ""

# can bus support
ENABLE_SPI_BUS = "1"
ENABLE_CAN = "1"
CAN_OSCILLATOR = "8000000"

ENABLE_I2C = "1"

IMAGE_FSTYPES += "wic"
# WKS_FILE = "sdimage-bootpart.wks"
# extra rootfs size in kbyte e.g. 4GB = 4194304; 1GB = 1048576
IMAGE_ROOTFS_EXTRA_SPACE = "1048576"

KERNEL_DEVICETREE = " \
    bcm2708-rpi-zero-w.dtb \
    overlays/mcp2515-can0.dtbo \
    overlays/mcp2515-can1.dtbo \
    "
```
