## meta-ams-bsp/conf/machine/rpi2-2in7epaper.conf
```bitbake
#@TYPE: Machine
#@NAME: Board Configuration rpi2-2in7epaper
#@DESCRIPTION: Board Configuration based on raspberrypi2, with 2.7 inch ePaper display
#@MAINTAINER: Volker Kempert <volker.kempert@almedso.de>

# see  https://readthedocs.org/projects/meta-raspberrypi/
# 2.7 inch display:
# - https://www.waveshare.com/product/displays/e-paper/2.7inch-e-paper-hat.htm
# - https://www.waveshare.com/wiki/2.7inch_e-Paper_HAT_Manual#Working_With_Raspberry_Pi
# - demo/dirver: https://github.com/waveshare/e-Paper

DEFAULTTUNE ?= "cortexa7thf-neon-vfpv4"

require conf/machine/include/arm/armv7a/tune-cortexa7.inc
include conf/machine/include/rpi-base.inc

SDIMG_KERNELIMAGE ?= "kernel7.img"
SERIAL_CONSOLES ?= "115200;ttyAMA0"
UBOOT_MACHINE = "rpi_2_config"

ARMSTUB ?= "armstub7.bin"

# prepend raspberry 2 to make sure the kernel is correctly build
MACHINEOVERRIDES =."raspberrypi2:"

MACHINE_FEATURES:remove = "keyboard screen touchscreen alsa sdio"

# Enable the console (as serial0 in kernel cmdline.txt) and in config.txt
ENABLE_UART = "1"

IMAGE_FSTYPES += "wic"
# extra rootfs size in kbyte e.g. 4 GB here
IMAGE_ROOTFS_EXTRA_SPACE = "4194304"

SPLASH = ""

ENABLE_SPI_BUS = "1"
ENABLE_I2C = "1"
RPI_EXTRA_CONFIG += "dtoverlay=spi0-1cs"

KERNEL_MODULE_AUTOLOAD:rpi += "i2c-dev i2c-bcm2708"

KERNEL_DEVICETREE = " \
    bcm2710-rpi-2-b.dtb \
    "
```
