## meta-ams-bsp/conf/machine/rpi4-cam.conf
```bitbake
#@TYPE: Machine
#@NAME: Board Configuration RaspberryPi4 with mpi-csi cam 
#@COM: raspberrypi
#@DESCRIPTION: Board Configuration raspberrypi4, mipi-csi cam,  w/ console)
#@MAINTAINER: Volker Kempert <volker.kempert@almedso.de>

# see  https://readthedocs.org/projects/meta-raspberrypi/

MACHINEOVERRIDES = "raspberrypi4:${MACHINE}"
require conf/machine/raspberrypi4.conf

MACHINE_FEATURES:remove = "keyboard screen touchscreen alsa sdio"

IMAGE_FSTYPES = "wic"
# extra rootfs size in kbyte e.g. 4 GB here
# IMAGE_ROOTFS_EXTRA_SPACE = "4194304"

SPLASH = ""

# video for linix driver support
VIDEO_CAMERA = "1"
RASPBERRYPI_CAMERA_HQ = "1"

MACHINE_EXTRA_RRECOMMENDS += " rpi-config"

# RPI_USE_U_BOOT = "1"
```

## meta-ams-bsp/conf/machine/ruiz.conf
```bitbake
#@TYPE: Machine
#@NAME: Board Configuration "ruiz"
#@COM: raspberrypi
#@DESCRIPTION: Board Configuration "ruiz" (based on raspberrypi3, w/ touch, display)
#@MAINTAINER: Volker Kempert <volker.kempert@almedso.de>


MACHINEOVERRIDES = "raspberrypi3:${MACHINE}"
require conf/machine/raspberrypi3.conf

# MACHINE_FEATURES_remove = "sdio"
# Driver to support weston / graphics
MACHINE_FEATURES += "vc4graphics"

# Remove black border
DISABLE_OVERSCAN = "1"

# Heavily recommended for Wayland/Weston.
DISPMANX_OFFLINE = "1"

GPU_MEM = "128"

IMAGE_FSTYPES += "wic"

SPLASH = "psplash-ams"

# Touch screen setting
WAVESHARE_800X480_RPI = "1"
MACHINE_FEATURES += "ads7846-touch"
```

## meta-ams-jupyter/conf/layer.conf
```bitbake
# We have a conf and classes directory, add to BBPATH
BBPATH .= ":${LAYERDIR}"

# We have recipes-* directories, add to BBFILES
BBFILES += "${LAYERDIR}/recipes-*/*/*.bb \
            ${LAYERDIR}/recipes-*/*/*.bbappend"

BBFILE_COLLECTIONS += "ams-jupyter"
BBFILE_PATTERN_ams-jupyter = "^${LAYERDIR}/"
# High priority since it provides simple frame to develop BSP's in isolation
# from applications
BBFILE_PRIORITY_ams-jupyter = "50"
LAYERVERSION_ams-jupyter = "1"
# LAYERSERIES_COMPAT_ams-jupyter = "kirkstone"

# provided by: https://github.com/Xilinx/meta-jupyter
LAYERDEPENDS_ams-jupyter = "jupyter-layer "
```

## meta-ams/conf/distro/ams.conf
```bitbake
# Enforced inherits
#------------------------------------------------------------------------------
INHERIT += "uninative"
INHERIT += "reproducible_build"

# QA check settings - a little stricter than the OE-Core defaults
WARN_TO_ERROR_QA = "already-stripped compile-host-path install-host-path \
                    installed-vs-shipped ldflags pn-overrides rpaths staticdev \
                    unknown-configure-option useless-rpaths"

require conf/distro/include/poky-copy.inc

DISTRO = "ams"
DISTRO_NAME = "AMS Distribution"
DISTRO_VERSION = "2020-Q3"

BUILD_VARIANT = "prod"
TARGET_VENDOR = "-ams"

OPKG_ARGS:remove = "--prefer-arch-to-version"

DISTRO_FEATURES_LIBC += "libc-locales"

DISTRO_FEATURES = "\
  ${DISTRO_FEATURES_LIBC} \
  bluez5 \
  bluetooth \
  ext2 \
  ipv4 ipv6 \
  largefile \
  multiarch \
  opengl \
  pam \
  ptest \
  usbgadget \
  systemd \
  wayland  \
  wifi \
  vulcan \
  xattr \
"
DISTRO_FEATURES:append = " virtualization"

VIRTUAL-RUNTIME_init_manager = "systemd"
DISTRO_FEATURES_BACKFILL_CONSIDERED = "sysvinit"

PACKAGE_CLASSES ?= "package_ipk"
PACKAGE_FEED_URIS ?= "http://ams.almedso.de/feeds"

ENTERPRISE_DISTRO = "1"

SANITY_TESTED_DISTROS = " \
  ubuntu-18.04 \n \
  ubuntu-20.04 \n \
  "

# Some ptests (glibc, bash, python3) depend
# on other locales to be included
GLIBC_GENERATE_LOCALES = " \
    en_US.UTF-8 \
    en_GB.UTF-8 \
    pt_PT.UTF-8 \
    pt_BR.UTF-8 \
    fi_FI.UTF-8 \
    it_IT.UTF-8 \
    nl_NL.UTF-8 \
    nb_NO.UTF-8 \
    nn_NO.UTF-8 \
    sv_SE.UTF-8 \
    el_GR.UTF-8 \
    es_ES.UTF-8 \
    fa_IR.UTF-8 \
    fr_FR.ISO-8859-1 \
    fr_FR.UTF-8 \
    hr_HR.UTF-8 \
    lt_LT.UTF-8 \
    pl_PL.UTF-8 \
    ru_RU.UTF-8 \
    tr_TR.ISO-8859-9 \
    de_DE.UTF-8 \
    ja_JP.EUC-JP \
    zh_HK.BIG5-HKSCS \
    tr_TR.UTF-8 \
    pl_PL.ISO-8859-2 \
"
IMAGE_LINGUAS = " \
    en-us \
    en-gb \
    pt-pt \
    pt-br \
    fi-fi \
    it-it \
    nl-nl \
    nb-no \
    nn-no \
    sv-se \
    el-gr \
    es-es \
    fa-ir \
    fr-fr \
    hr-hr \
    lt-lt \
    pl-pl \
    ru-ru \
    tr-tr \
    de-de \
    ja-jp.euc-jp \
    zh-hk.big5-hkscs \
    tr-tr \
"

# Uninative is enabled by default when deriving from poky distro
# It's a prebuild glibc designed to remove the differences between
# host distros, meaning that native sstate objects can be shared
# between host distros.

# Do not do this if you are using package feeds.
ERROR_QA:remove = "version-going-backwards"
```

## meta-ams/conf/distro/include/poky-copy.inc
```bitbake
SDK_VENDOR = "-amssdk"
SDK_VERSION = "${@d.getVar('DISTRO_VERSION').replace('snapshot-${DATE}', 'snapshot')}"

DISTRO_VERSION[vardepsexclude] = "DATE"
SDK_VERSION[vardepsexclude] = "DATE"

# Override these in poky based distros
POKY_DEFAULT_EXTRA_RDEPENDS = "packagegroup-core-boot"
POKY_DEFAULT_EXTRA_RRECOMMENDS = "kernel-module-af-packet"
DISTRO_EXTRA_RDEPENDS += " ${POKY_DEFAULT_EXTRA_RDEPENDS}"
DISTRO_EXTRA_RRECOMMENDS += " ${POKY_DEFAULT_EXTRA_RRECOMMENDS}"

PREFERRED_VERSION_linux-yocto ?= "5.2%"

SDK_NAME = "${DISTRO}-${TCLIBC}-${SDKMACHINE}-${IMAGE_BASENAME}-${TUNE_PKGARCH}-${MACHINE}"
SDKPATH = "/opt/${DISTRO}/${SDK_VERSION}"

POKYQEMUDEPS = "${@bb.utils.contains("INCOMPATIBLE_LICENSE", "GPL-3.0", "", "packagegroup-core-device-devel",d)}"
DISTRO_EXTRA_RDEPENDS_append_qemuarm = " ${POKYQEMUDEPS}"
DISTRO_EXTRA_RDEPENDS_append_qemuarm64 = " ${POKYQEMUDEPS}"
DISTRO_EXTRA_RDEPENDS_append_qemuppc = " ${POKYQEMUDEPS}"
DISTRO_EXTRA_RDEPENDS_append_qemux86-64 = " ${POKYQEMUDEPS}"

TCLIBCAPPEND = ""

PREMIRRORS ??= "\
bzr://.*/.*   http://downloads.yoctoproject.org/mirror/sources/ \n \
cvs://.*/.*   http://downloads.yoctoproject.org/mirror/sources/ \n \
git://.*/.*   http://downloads.yoctoproject.org/mirror/sources/ \n \
gitsm://.*/.* http://downloads.yoctoproject.org/mirror/sources/ \n \
hg://.*/.*    http://downloads.yoctoproject.org/mirror/sources/ \n \
osc://.*/.*   http://downloads.yoctoproject.org/mirror/sources/ \n \
p4://.*/.*    http://downloads.yoctoproject.org/mirror/sources/ \n \
svn://.*/.*   http://downloads.yoctoproject.org/mirror/sources/ \n"

SANITY_TESTED_DISTROS ?= " \
            ubuntu-18.04 \n \
            "
#
# OELAYOUT_ABI allows us to notify users when the format of TMPDIR changes in
# an incompatible way. Such changes should usually be detailed in the commit
# that breaks the format and have been previously discussed on the mailing list
# with general agreement from the core team.
#
OELAYOUT_ABI = "12"

# add poky sanity bbclass
INHERIT += "poky-sanity"

# QA check settings - a little stricter than the OE-Core defaults
WARN_TO_ERROR_QA = "already-stripped compile-host-path install-host-path \
                    installed-vs-shipped ldflags pn-overrides rpaths staticdev \
                    unknown-configure-option useless-rpaths"
WARN_QA_remove = "${WARN_TO_ERROR_QA}"
ERROR_QA_append = " ${WARN_TO_ERROR_QA}"

require conf/distro/include/no-static-libs.inc
require conf/distro/include/yocto-uninative.inc
require conf/distro/include/security_flags.inc

INHERIT += "uninative"
```

## meta-ams/conf/layer.conf
```bitbake
# We have a conf and classes directory, add to BBPATH
BBPATH =. "${LAYERDIR}:"

BBFILE_COLLECTIONS += "ams"
BBFILE_PATTERN_ams = "^${LAYERDIR}/"

BBFILE_PRIORITY_ams = "40"
LAYERVERSION_ams = "4"
LAYERSERIES_COMPAT_ams = "kirkstone mickledore"

LAYERDEPENDS_ams = "core"

# Set a variable to get to the top of the metadata location
PLOSCOREBASE = '${@os.path.normpath("${LAYERDIR}/../")}'
# Add your custom license files into one of this directories.
# LICENSE_PATH += "${LAYERDIR}/files/custom-licenses"

BBFILES += "${LAYERDIR}/recipes-*/*/*.bb \
            ${LAYERDIR}/recipes-*/*/*.bbappend"
```

## meta-ams/conf/local.conf.sample
```bitbake
DISTRO ?= 'ams'

PACKAGE_CLASSES ?= "package_ipk"
EXTRA_IMAGE_FEATURES ?= "debug-tweaks"

USER_CLASSES ?= "buildstats image-mklibs image-prelink"
PATCHRESOLVE = "noop"

BB_DISKMON_DIRS ??= "\
    STOPTASKS,${TMPDIR},1G,100K \
    STOPTASKS,${DL_DIR},1G,100K \
    STOPTASKS,${SSTATE_DIR},1G,100K \
    STOPTASKS,/tmp,100M,100K \
    ABORT,${TMPDIR},100M,1K \
    ABORT,${DL_DIR},100M,1K \
    ABORT,${SSTATE_DIR},100M,1K \
    ABORT,/tmp,10M,1K"

# qemu specifics
PACKAGECONFIG_append_pn-qemu-native = " sdl"
PACKAGECONFIG_append_pn-nativesdk-qemu = " sdl"

CONF_VERSION = "1"

BB_NUMBER_THREADS = '4'
PARALLEL_MAKE = '-j 4'

# overwrite in site.conf
DL_DIR ?= "${BSPDIR}/downloads/"

# raspberry predefinitions
MACHINE ?= 'raspberrypi0-wifi'
MACHINE ?= 'raspberrypi3'

# freescale/nxp predefinitions
MACHINE ?= 'imx6dl-riotboard'
ACCEPT_FSL_EULA = "1"
```

## meta-plos-bsp/conf/machine/rigoletto.conf
```bitbake
#@TYPE: Machine
#@NAME: Board Configuration "Rigoletto"
#@SOC: i.MX6 Solo
#@COM: riotboard
#@DESCRIPTION: Machine configuration for Board Configuration "Rigoletto" (based on riotboard)
#@MAINTAINER: Volker Kempert <volker.kempert@pixmeter.com>

# derived from riotboard
include conf/machine/imx6dl-riotboard.conf

# SOC_FAMILY_append = ":imx6dl-riotboard"
# IMAGE FSTYPES = "sdcard"

# overwrite u-boot
PREFERRED_PROVIDER_u-boot = "u-boot-riotboard"

UBOOT_MACHINE = "mx6solo_RIoTboard_config"

KERNEL_IMAGETYPE = "uImage"

# Add gstreamer plugins provided by Freescale
# MACHINE_EXTRA_RRECOMMENDS += "gst-fsl-plugin"
```

## meta-plos/conf/distro/plos.conf
```bitbake
require conf/distro/poky.conf

DISTRO = "plos"
DISTRO_NAME = "PLOS Distribution, derived from poky"

DISTRO_FEATURES = "systemd wayland xattr usbgadget ext2 largefile wifi opengl ${DISTRO_FEATURES_LIBC}"

VIRTUAL-RUNTIME_init_manager = "systemd"
DISTRO_FEATURES_BACKFILL_CONSIDERED = "sysvinit"

PACKAGE_CLASSES = "package_ipk"
PACKAGE_FEED_URIS = "http://worker.pixmeter.com/packages"
```

## meta-plos/conf/layer.conf
```bitbake
# We have a conf and classes directory, add to BBPATH
BBPATH =. "${LAYERDIR}:"

# We have recipes-* directories, add to BBFILES
BBFILES += "${LAYERDIR}/recipes-*/*/*.bb \
            ${LAYERDIR}/recipes-*/*/*.bbappend"

BBFILE_COLLECTIONS += "plos"
BBFILE_PATTERN_plos = "^${LAYERDIR}/"
BBFILE_PRIORITY_plos = "6"

# This should only be incremented on significant changes that will
# cause compatibility issues with other layers
LAYERVERSION_plos = "1"

LAYERDEPENDS_plos = "yocto"

# Set a variable to get to the top of the metadata location
PLOSCOREBASE = '${@os.path.normpath("${LAYERDIR}/../")}'

# Additional custom license directories.
# Add your custom licenses directories this path.
# Add your custom license files into one of this directories.
LICENSE_PATH += "${LAYERDIR}/files/custom-licenses"
```
